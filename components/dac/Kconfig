## components/dac/Kconfig
```kconfig
menu "DAC Configuration"

    config DAC_TAS57XX
        bool "TI TAS57xx (TAS5754/TAS5756)"
        default n
        help
            Build the TI TAS5754M / TAS5756M DAC/amplifier driver.
            The board must register it at runtime via dac_register().

    config DAC_TAS58XX
        bool "TI TAS58xx (TAS5825M)"
        default n
        help
            Build the TI TAS5825M DAC/amplifier driver.
            The board must register it at runtime via dac_register().

    config DAC_ES8388
        bool "Everest ES8388 codec"
        default n
        help
            Build the ES8388 codec driver wrapper for ESP32-A1S style boards.

    config ES8388_I2C_ADDR
        int "ES8388 I2C address (7-bit)"
        default 16
        depends on DAC_ES8388
        help
            7-bit I2C address. ESP32-A1S ES8388 boards usually use 0x10.

    config DAC_CONTROLS_VOLUME
        bool
        default y if DAC_TAS57XX || DAC_TAS58XX || DAC_ES8388
        help
            Hidden option. Set automatically when a hardware DAC driver is enabled.
            When true, the DAC handles volume control and software attenuation
            is skipped in the audio output path.

endmenu
```

## sdkconfig.defaults.esp32-a1s
```kconfig
# Ai-Thinker ESP32-A1S Audio Kit V2.2+ ES8388
CONFIG_BOARD_ESP32_A1S=y
CONFIG_ESPTOOLPY_FLASHSIZE_4MB=y
CONFIG_ESPTOOLPY_FLASHSIZE="4MB"
CONFIG_PARTITION_TABLE_CUSTOM_FILENAME="components/boards/partitions-4m.csv"

# ES8388 codec
CONFIG_DAC_ES8388=y
CONFIG_DAC_CONTROLS_VOLUME=y
CONFIG_ES8388_I2C_ADDR=16
CONFIG_CODEC_ES8388_SUPPORT=y

# ESP32-A1S ES8388 pins from the working SqueezeLite UI / Ai-Thinker docs
CONFIG_I2S_SCK_IO=0
CONFIG_I2S_BCK_IO=27
CONFIG_I2S_WS_IO=25
CONFIG_I2S_DO_IO=26
CONFIG_DAC_I2C_SDA=33
CONFIG_DAC_I2C_SCL=32
CONFIG_SPDIF_DO_IO=-1

# Optional board GPIOs disabled for now.
CONFIG_LED_STATUS_GPIO=-1
CONFIG_LED_ERROR_GPIO=-1
CONFIG_LED_RGB_GPIO=-1
CONFIG_JACK_GPIO=-1
CONFIG_SPKFAULT_GPIO=-1
CONFIG_MUTE_GPIO=21

# No display/Ethernet on this target.
CONFIG_DISPLAY_ENABLED=n
CONFIG_ETH_W5500_ENABLED=n

# Buttons disabled because several A1S button pins overlap audio/I2C.
CONFIG_BTN_PLAY_PAUSE_GPIO=-1
CONFIG_BTN_VOLUME_UP_GPIO=-1
CONFIG_BTN_VOLUME_DOWN_GPIO=-1
CONFIG_BTN_NEXT_GPIO=-1
CONFIG_BTN_PREV_GPIO=-1

# --- WiFi / decode tuning override for AirPlay-primary use --------------------
# sdkconfig.defaults.bt assumed "AirPlay is stopped while BT streams" and
# trimmed WiFi to give BT headroom.  This device does the OPPOSITE: BT is
# stopped while AirPlay streams (see main.c on_airplay_client_event).  The
# trimmed config strangles the realtime ALAC/UDP path (type=96, ~125 pps,
# 200 ms jitter buffer): undersized RX buffers + flash-resident RX ISR cause
# 10-25 packets/s loss with audible drops every ~100 ms.
#
# Restore full WiFi sizing.  BT is OK with these too because the BT path
# only matters while AirPlay is idle (no UDP RX pressure).
CONFIG_ESP_WIFI_STATIC_RX_BUFFER_NUM=10
CONFIG_ESP_WIFI_DYNAMIC_RX_BUFFER_NUM=32
CONFIG_ESP_WIFI_DYNAMIC_TX_BUFFER_NUM=32
CONFIG_ESP_WIFI_RX_BA_WIN=16
CONFIG_ESP_WIFI_IRAM_OPT=y
CONFIG_ESP_WIFI_RX_IRAM_OPT=y

# Restore perf optimization for ALAC decode under the realtime budget.
# sdkconfig.defaults.bt switched to SIZE for IRAM pressure with BT enabled;
# with the WiFi IRAM_OPT toggles above and no flash-placement of heap/ringbuf
# below, PERF fits and decodes ~15% faster.
CONFIG_COMPILER_OPTIMIZATION_PERF=y

# Undo the flash-placement nudges from .bt — they helped IRAM headroom when
# BT was the bottleneck.  With BT-on-demand they cost too much on the UDP path.
CONFIG_FREERTOS_PLACE_FUNCTIONS_INTO_FLASH=n
CONFIG_RINGBUF_PLACE_FUNCTIONS_INTO_FLASH=n
CONFIG_HEAP_PLACE_FUNCTION_INTO_FLASH=n
```
